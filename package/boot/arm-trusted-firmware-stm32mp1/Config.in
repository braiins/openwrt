## package/boot/arm-trusted-firmware-stm32mp1/Config.in
```kconfig
config EXTERNAL_ARM_TRUSTED_FIRMWARE_STM32MP1_TREE
    string "Use external STM32MP1 TF-A tree" if DEVEL
    default ""

config ARM_TRUSTED_FIRMWARE_STM32MP1_DEBUG
    bool "Enable debug build for STM32MP1 TF-A"
    default n
```

## package/boot/arm-trusted-firmware-stm32mp15/Config.in
```kconfig
config EXTERNAL_ARM_TRUSTED_FIRMWARE_STM32MP15_TREE
    string "Use external STM32MP15 TF-A tree" if DEVEL
    default ""

config ARM_TRUSTED_FIRMWARE_STM32MP15_DEBUG
    bool "Enable debug build for STM32MP15 TF-A"
    default n
```

## package/boot/boot-ii1-stm/Config.in
```kconfig
config DTB_VARIANT_stm32mp1_ii1
    string "Use DTB variant for STM32MP1"
    default ""
```

## package/boot/boot-stm32mp15_ii1/Config.in
```kconfig
config DTB_VARIANT_stm32mp15_ii1
    string "Use DTB variant for STM32MP15"
    default ""
```

## package/boot/uboot-stm32mp1/Config.in
```kconfig
config EXTERNAL_UBOOT_STM32MP1_TREE
    string "Use external STM32MP1 U-Boot tree" if DEVEL
    default ""
```

## package/boot/uboot-stm32mp15/Config.in
```kconfig
config EXTERNAL_UBOOT_STM32MP15_TREE
    string "Use external STM32MP15 U-Boot tree" if DEVEL
    default ""
```

## package/kernel/esp32-sdio/Config.in
```kconfig
config EXTERNAL_ESP32_SDIO_TREE
    string "Use external ESP32 SDIO tree" if DEVEL
    default ""
```
